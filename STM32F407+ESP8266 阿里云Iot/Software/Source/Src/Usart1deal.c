/*
********************************************************************************************
 版权所有 (C)，2011－2015，泉州禾逸电子有限公司
----------------------------------------------------------------------------------------
源程序文件名：　　　UartRadio.c
源程序名称：　　　　无线接收处理源程序
程序版本：　　      1.0
程序功能：
　　　　
程序说明：
　　　　
主要函数列表：　　　
　　　　

链接子程序文件：　　
　　　　

编译工具软件：      

编作者：            
编制日期：          
----------------------------------------------------------------------------------------
适用器件芯片类型：  
器件芯片时钟频率：  任意
存储器模式：        大存储器模式
外部扩展存储器大小：0【字节】
调用堆栈大小：      0 【字节】
数据堆栈大小：      0 【字节】
----------------------------------------------------------------------------------------
源程序版本历史：
年月日  〖〗 -------- 版本 1.0 ：原始版本
********************************************************************************************
*/

/*==========================================================================================
                                        调试开关声明
==========================================================================================*/
//#define DEBUG


/*==========================================================================================
　　　　　　　　　　　　　　        本源程序包括的头文件
建议：包含本项目的文件使用 #include "文件名.扩展名" ，
　　　包含系统库的文件使用 #include <文件名.扩展名> 。
==========================================================================================*/
#include "Usart1deal.h"                        // 串口1发送数据处理的头文件


/*==========================================================================================
下面这三条指令是用于区分编译系统为 C++ 或 C 的预处理指令。
"__cplusplus" 为 C++ 预处理器名字，这三条指令表明接在其下面的那些指令为 C 程序特征。
==========================================================================================*/
#ifdef __cplusplus
extern "C" {
#endif

/*==========================================================================================
                            本源程序文件内部使用的字符化常数定义
==========================================================================================*/

/*--------------------------------------------------------------------------------------
的字符化常数定义：
--------------------------------------------------------------------------------------*/
//#define		Debug				// 调试开关

/*==========================================================================================
                             本源程序文件内部使用的函数原型声明
==========================================================================================*/


/*==========================================================================================
                       本源程序文件内部使用的局部常量、字符化常数定义
==========================================================================================*/

/*--------------------------------------------------------------------------------------
的局部常量、字符化常数定义：
--------------------------------------------------------------------------------------*/




/*==========================================================================================
                                        全局常量定义
==========================================================================================*/


/*==========================================================================================
                                        全局变量定义
==========================================================================================*/
/*--------------------------------------------------------------------------------------
串口1调试打印标志的全局常量声明：
--------------------------------------------------------------------------------------*/
PrintfUsart1Bits gbitPrintf;

/*--------------------------------------------------------------------------------------
串口1调试打印的全局数据结构类型的全局常量声明：
--------------------------------------------------------------------------------------*/
PrintfUsart1Stru gstvPrintf;

/*==========================================================================================
                             本源程序文件内部使用的局部变量定义
==========================================================================================*/

/*
********************************************************************************************
                             　       程序指令代码清单
********************************************************************************************
*/
/*--------------------------------------------------------------------------------------
函数名称：    初始化串口1发送功能
函数功能：    本函数用于初始化串口1发送功能
函数入口参数：bound: 波特率
函数返回值：  没有
调用函数：　　１．
　　　　　　　　　
备注：        本函数仅在主函数中调用一次即可。
--------------------------------------------------------------------------------------*/
void PrintUsart1_Init(void)
{
  GPIO_InitTypeDef   GPIO_InitStructure; 
	USART_InitTypeDef  USART_InitStructure;
  
#if USART1_RX_ENABLE 
	NVIC_InitTypeDef   NVIC_InitStructure;
	NVIC_PriorityGroupConfig(NVIC_PriorityGroup_2); 
#endif	

	RCC_AHB1PeriphClockCmd(cPrintfRxPortClk, ENABLE); 
	RCC_AHB1PeriphClockCmd(cPrintfTxPortClk, ENABLE); 
  RCC_APB2PeriphClockCmd(cPrintfUsart1Clk, ENABLE);
 
	/* 串口1对应引脚复用映射 */
	GPIO_PinAFConfig(cPrintfTxPort, cPrintfTxSource, cPrintfTxAF);
	GPIO_PinAFConfig(cPrintfRxPort, cPrintfRxSource, cPrintfRxAF); 
	
	/* USART1 Tx端口配置 */
	GPIO_InitStructure.GPIO_Pin   = cPrintfTxPin;
	GPIO_InitStructure.GPIO_Mode  = GPIO_Mode_AF;
	GPIO_InitStructure.GPIO_Speed = GPIO_Speed_50MHz;	
	GPIO_InitStructure.GPIO_OType = GPIO_OType_PP; 
	GPIO_InitStructure.GPIO_PuPd  = GPIO_PuPd_UP; 
	GPIO_Init(cPrintfTxPort,&GPIO_InitStructure); 

	/* USART1 Rx端口配置 */
	GPIO_InitStructure.GPIO_Pin   = cPrintfRxPin;
	GPIO_InitStructure.GPIO_Mode  = GPIO_Mode_AF;
	GPIO_InitStructure.GPIO_Speed = GPIO_Speed_50MHz;	
	GPIO_InitStructure.GPIO_OType = GPIO_OType_PP; 
	GPIO_InitStructure.GPIO_PuPd  = GPIO_PuPd_UP; 
	GPIO_Init(cPrintfRxPort,&GPIO_InitStructure); 

  /* USART1 初始化设置 */
	USART_InitStructure.USART_BaudRate            = cPrintfBaudrate;
	USART_InitStructure.USART_WordLength          = USART_WordLength_8b;
	USART_InitStructure.USART_StopBits            = USART_StopBits_1;
	USART_InitStructure.USART_Parity              = USART_Parity_No;
	USART_InitStructure.USART_HardwareFlowControl = USART_HardwareFlowControl_None;
#if USART1_RX_ENABLE
	USART_InitStructure.USART_Mode = USART_Mode_Rx | USART_Mode_Tx;	
#else
	USART_InitStructure.USART_Mode = USART_Mode_Tx;	
#endif

	USART_Init(cPrintfUsart1, &USART_InitStructure); 

#if USART1_RX_ENABLE	
  USART_ClearFlag(cPrintfUsart1, USART_FLAG_RXNE);
	USART_ITConfig(cPrintfUsart1,  USART_IT_RXNE, ENABLE);

	/* Usart1 NVIC 配置 */
	NVIC_InitStructure.NVIC_IRQChannel                   = USART1_IRQn;
	NVIC_InitStructure.NVIC_IRQChannelPreemptionPriority = 0;
	NVIC_InitStructure.NVIC_IRQChannelSubPriority        = 0;	
	NVIC_InitStructure.NVIC_IRQChannelCmd                = ENABLE;			
	NVIC_Init(&NVIC_InitStructure);	

#endif

	USART_Cmd(cPrintfUsart1, ENABLE);
}


/*--------------------------------------------------------------------------------------
函数名称：    串口1 printf 函数
函数功能：    本函数用于串口1 printf 函数
函数入口参数：char* fmt,...  格式化输出字符串和参数   
函数返回值：  没有
调用函数：　　１．
　　　　　　　　　
备注：        本函数仅在主函数中调用一次即可。
--------------------------------------------------------------------------------------*/
void u1_printf(char *fmt, ...)
{
  unsigned int i, length;

  va_list ap;
  va_start(ap, fmt);
  vsprintf((char *)gstvPrintf.TxBuff, fmt, ap);
  va_end(ap);

  length = strlen((const char *)gstvPrintf.TxBuff);
  while((USART1->SR & 0x40) == 0);

  for(i = 0; i < length; i++)
  {
    USART1->DR = gstvPrintf.TxBuff[i];
    while((USART1->SR & 0x40) == 0);
  }
}















/*==========================================================================================
下面这三条指令是用于与上面三条区分编译系统为 C++ 或 C 的预处理指令相对应。用于指定
 extern "C" 链接指示符作用域，此处的"}"与上面的"{"相对应，为链接指示符作用结束符。
==========================================================================================*/
#ifdef __cplusplus
}
#endif


/*
********************************************************************************************
                                 本Ｃ语言源程序文件到此结束
********************************************************************************************
*/








